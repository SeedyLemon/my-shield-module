## config/boards/shields/split 2/Kconfig.defconfig
```kconfig
if SHIELD_SPLIT_LEFT_2

config ZMK_KEYBOARD_NAME
    default "Split Left"

config ZMK_SPLIT_ROLE_CENTRAL
    default y

endif

if SHIELD_SPLIT_LEFT_2 || SHIELD_SPLIT_RIGHT_2

config ZMK_SPLIT
    default y

endif
```

## config/boards/shields/split 2/Kconfig.shield
```kconfig
config SHIELD_SPLIT_LEFT_2
    def_bool $(shields_list_contains,split_left_2)

config SHIELD_SPLIT_RIGHT_2
    def_bool $(shields_list_contains,split_right_2)
```

## config/boards/shields/woody/Kconfig.defconfig
```kconfig
if SHIELD_WOODY_LEFT

config ZMK_KEYBOARD_NAME
    default "Woody Left"

config ZMK_WOODY_ROLE_CENTRAL
    default y

endif

if SHIELD_WOODY_LEFT || SHIELD_WOODY_RIGHT

config ZMK_WOODY
    default y

endif
```

## config/boards/shields/woody/Kconfig.shield
```kconfig
config SHIELD_WOODY_LEFT
    def_bool $(shields_list_contains,woody_left)

config SHIELD_WOODY_RIGHT
    def_bool $(shields_list_contains,woody_right)
```
